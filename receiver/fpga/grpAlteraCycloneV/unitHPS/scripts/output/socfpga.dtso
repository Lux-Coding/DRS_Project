/dts-v1/;
/plugin/;
/ {
	fragment {
		target-path = "/sopc@0/base-fpga-region";
		#address-cells = <1>;
		#size-cells = <1>;
        
		__overlay__@0 {
			#address-cells = <2>;
			#size-cells = <1>;
			firmware-name = "socfpga.rbf";
             
			reg = <0xc0000000 0x20000000>,
				  <0xff200000 0x00200000>;
			reg-names = "axi_h2f", "axi_h2f_lw";
            
			ranges = <0x00000000 0x00000000 0xc0000000 0x20000000>,
                     <0x00000001 0x00000000 0xff200000 0x00200000>;
         
		    

			DRS_Receiver_Interface_0: unknown@100000000 {
				compatible = "unknown,unknown-1.0";
				reg = <0x00000001 0x00000000 0x00000010>;
				interrupt-parent = <&hps_0_arm_gic_0>;
				interrupts = <0 40 4>;
				clocks = <&clk_0>;
			}; //end unknown@0x100000000 (DRS_Receiver_Interface_0)
		

			
			/* sld_hub_controller_system_0_link: debug@0 {
                #address-cells = <1>;
                #size-cells = <1>;
				compatible = "altr,altera_mm_debug_link-17.1", "altr,mm-debug-link-1.0";
				reg = <0x00000000 0x00000000 0x00000080>;
			}; //end debug@0x000000000 (sld_hub_controller_system_0_link)
			*/	
		};
	};
};
