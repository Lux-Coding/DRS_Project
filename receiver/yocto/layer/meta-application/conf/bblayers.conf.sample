## receiver/yocto/layer/meta-application/conf/bblayers.conf.sample
```bitbake
# POKY_BBLAYERS_CONF_VERSION is increased each time build/conf/bblayers.conf
# changes incompatibly
POKY_BBLAYERS_CONF_VERSION = "2"

BBPATH = "${TOPDIR}"
BBFILES ?= ""

BBLAYERS ?= " \
  ##OEROOT##/meta \
  ##OEROOT##/meta-poky \
  ##OEROOT##/meta-yocto-bsp \
  ##OEROOT##/../layer/meta-openembedded/meta-oe \
  ##OEROOT##/../layer/meta-openembedded/meta-python \
  ##OEROOT##/../layer/meta-openembedded/meta-networking \
  ##OEROOT##/../layer/meta-openembedded/meta-webserver \
  ##OEROOT##/../layer/meta-altera \
  ##OEROOT##/../layer/meta-application \
  ##OEROOT##/../layer/meta-mingw \
  "
```

## receiver/yocto/layer/meta-application/conf/layer.conf
```bitbake
# We have a conf and classes directory, add to BBPATH
BBPATH .= ":${LAYERDIR}"

# We have recipes-* directories, add to BBFILES
#BBFILES += "${LAYERDIR}/recipes-*/*/*.bb ${LAYERDIR}/recipes-*/*/*.bbappend"
BBFILES += "${LAYERDIR}/recipes*/*/*.bb ${LAYERDIR}/recipes*/*/*.bbappend"

BBFILE_COLLECTIONS += "application"
BBFILE_PATTERN_application = "^${LAYERDIR}/"
BBFILE_PRIORITY_application = "6"

# This should only be incremented on significant changes that will
# cause compatibility issues with other layers
LAYERVERSION_application = "2"

LAYERDEPENDS_application = "core"

LAYERSERIES_COMPAT_application = "dunfell"

# add addtional board support
# require machine/cyclone5-extra.conf
```
